## drivers/input/touchscreen/zinitix/zt7548/Kconfig
```kconfig
#
# Zinitix Touchscreen driver configuration
#

config CONFIG_TOUCHSCREEN_ZT7548_TS
	bool "ZINITIX ZT7548_TS touchscreen driver"
	depends on I2C
	default y
	help
	  Say Y here if you have a ZINITIX ZT7548 touchscreen.
	  If unsure, say N.
```

## drivers/input/touchscreen/zinitix/ztw522/Kconfig
```kconfig
#
# Zinitix Touchscreen driver configuration
#

config TOUCHSCREEN_ZINITIX_ZTW522
	tristate "ZINITIX ztw522 I2C Touchscreen"
	depends on I2C
	help
	  Say Y here if you have the ZINITIX 7538 I2C touchscreen
	  connected to your system.
	  If unsure, say N.
	  To compile this driver as a module, choose M here:
	  the module will be called Zinitix.
```

## drivers/power/supply/IP5328P/Kconfig
```kconfig
menuconfig POWER_SUPPLY
	bool "Power supply class support"
	help
	  Say Y here to enable power supply class support. This allows
	  power supply (batteries, AC, USB) monitoring by userspace
	  via sysfs and uevent (if available) and/or APM kernel interface
	  (if selected below).

if POWER_SUPPLY
config IP5328P
	tristate "Injoinic IP5328P"
	depends on I2C
	help
	  Say Y here to enable support for batteries with IP5328P chips
	  connected over an I2C bus.
endif # POWER_SUPPLY
```
